## drivers/input/touchscreen/mediatek/Kconfig
```kconfig
#
# Touchscreen driver configuration
#
menuconfig INPUT_TOUCHSCREEN
	bool "Touchscreens"
	help
	  Say Y here, and a list of supported touchscreens will be displayed.
	  This option doesn't affect the kernel.

	  If unsure, say Y.

if INPUT_TOUCHSCREEN

config TOUCHSCREEN_MTK
	bool "MediaTek Touch Panel Driver"
	help
	  Say Y here if you have MediaTek touch panel.

	  If unsure, say N.

	  To compile this dirver as a module, choose M here: the
	  module will be called.

config TOUCHSCREEN_MTK_GT1151
	bool "GT1151 for Mediatek package"
	default n
	help
	  Say Y here if you have GT1151 touch panel.

	  If unsure, say N.

	  To compile this dirver as a module, choose M here: the
	  module will be called.

source "drivers/input/touchscreen/mediatek/GT1151/Kconfig"

config TOUCHSCREEN_MTK_GT928
	tristate "GT928 Touchscreen"
	help
	  Say Y here if you have Goodix GT928 touchscreen,
	  connected to your system.
	  If unsure, say N.
	  To compile this driver as a module, choose M here.
config TOUCHSCREEN_MTK_GT9XXTB_HOTKNOT
	bool "GT9XXTB hotknot for Mediatek package"
	default n
	help
	  Say Y here if you have GT9xx touch panel.

	  If unsure, say N.

	  To compile this dirver as a module, choose M here: the
	  module will be called.

source "drivers/input/touchscreen/mediatek/GT9XXTB_hotknot/Kconfig"

config TOUCHSCREEN_MTK_SYNAPTICS_I2C_RMI4
	tristate "Synaptics DSX I2C touchscreen"
	depends on I2C
	help
	  Say Y here if you have a Synaptics DSX I2C touchscreen
	  connected to your system.

	  If unsure, say N.

	  To compile this driver as a module, choose M here: the
	  module will be called synaptics_i2c_rmi4.

source "drivers/input/touchscreen/mediatek/synaptics_i2c_rmi4/Kconfig"

config TOUCHSCREEN_MTK_GT910
	bool "GT910 for Mediatek package"
	default n
	help
	  Say Y here if you have GT910 touch panel.

	  If unsure, say N.

	  To compile this dirver as a module, choose M here: the
	  module will be called.

source "drivers/input/touchscreen/mediatek/GT910/Kconfig"

config TOUCHSCREEN_MTK_GT9XX_HOTKNOT_SCP
	bool "GT9XX_HOTKNOT_SCP for Mediatek package"
	default n
	help
	  Say Y here if you have GT9XX_HOTKNOT_SCP touch panel.

	  If unsure, say N.

	  To compile this dirver as a module, choose M here: the
	  module will be called.

source "drivers/input/touchscreen/mediatek/GT9XX_hotknot_scp/Kconfig"

config TOUCHSCREEN_MTK_GT911
	bool "GT911 for Mediatek package"
	default n
	help
	  Say Y here if you have GT911 touch panel.

	  If unsure, say N.

	  To compile this dirver as a module, choose M here: the
	  module will be called.

source "drivers/input/touchscreen/mediatek/GT911/Kconfig"

config TOUCHSCREEN_MTK_FT5X0X
	bool "FT5X0X for Mediatek package"
	default n
	help
	  Say Y here if you have FT5X0X touch panel.

	  If unsure, say N.

	  To compile this dirver as a module, choose M here: the
	  module will be called.

source "drivers/input/touchscreen/mediatek/ft5x0x/Kconfig"


config TOUCHSCREEN_MTK_FOCALTECH
	bool "FOCALTECH for Mediatek package"
	default n
	help
	  Say Y here if you have FOCALTECH touch panel.
	  If unsure, say N.
	  To compile this dirver as a module, choose M here: the
	  module will be called.
source "drivers/input/touchscreen/mediatek/focaltech/Kconfig"

config TOUCHSCREEN_MTK_ICN86XX
	bool "icn86xx for Mediatek package"
	default n
	help
	  Say Y here if you have FOCALTECH touch panel.
	  If unsure, say N.
	  To compile this dirver as a module, choose M here: the
	  module will be called.
source "drivers/input/touchscreen/mediatek/icn86xx/Kconfig"
config TOUCHSCREEN_MTK_GT9XX_V26
	bool "GT9XX V26 for Mediatek package"
	default n
	help
	  Say Y here if you have GT9XX V26 touch panel.
	  If unsure, say N.
	  To compile this dirver as a module, choose M here: the
	  module will be called.
source "drivers/input/touchscreen/mediatek/GT9XX_V26/Kconfig"

config TOUCHSCREEN_MTK_GT1X_V14
	bool "GT1X_V14 for Mediatek package"
	default n
	help
	  Say Y here if you have GT1X_V14 touch panel.
	  If unsure, say N.
	  To compile this dirver as a module, choose M here: the
	  module will be called.
source "drivers/input/touchscreen/mediatek/GT1X_V14/Kconfig"
config TOUCHSCREEN_MTK_GSL968
	bool "GSL968 for Mediatek package"
	default n
	help
	  Say Y here if you have GSL968 touch panel.
	  If unsure, say N.
	  To compile this dirver as a module, choose M here: the
	  module will be called.
source "drivers/input/touchscreen/mediatek/GSL968/Kconfig"
config TOUCHSCREEN_MTK_MSG28XX
	bool "GT9XX V26 for Mediatek package"
	default n
	help
	  Say Y here if you have GT9XX V26 touch panel.
	  If unsure, say N.
	  To compile this dirver as a module, choose M here: the
	  module will be called.
source "drivers/input/touchscreen/mediatek/msg28xx/Kconfig"
config TOUCHSCREEN_MTK_MSG2238
	bool "MSG2238 for Mediatek package"
	default n
	help
	  Say Y here if you have MSG2238 touch panel.
	  If unsure, say N.
	  To compile this dirver as a module, choose M here: the
	  module will be called.
source "drivers/input/touchscreen/mediatek/msg2238/Kconfig"
config TOUCHSCREEN_MTK_MSG5846
       bool "msg5846 for Mediatek package"
       default n
       help
         Say Y here if you have msg5846 touch panel.
         If unsure, say N.
         To compile this dirver as a module, choose M here: the
         module will be called.
source "drivers/input/touchscreen/mediatek/msg5846/Kconfig"

config TOUCHSCREEN_SYNAPTICS_3402
	bool "SYNAPTICS_3402 for Mediatek package"
	default n
	help
	  Say Y here if you have SYNAPTICS_3402 touch panel.
	  If unsure, say N.
	  To compile this dirver as a module, choose M here: the
	  module will be called.
source "drivers/input/touchscreen/mediatek/synaptics_3402/Kconfig"

config AW9136_SUPPORT
	bool "AW9136_SUPPORT for Mediatek package"
	default n
	help
	  Say Y here if you have AW9136_SUPPORT touch panel.
	  If unsure, say N.
	  To compile this dirver as a module, choose M here: the
	  module will be called.
source "drivers/input/touchscreen/mediatek/AW9136/Kconfig"

config TOUCHSCREEN_SYNAPTICS_OPPO
	bool "SYNAPTICS_oppl for Mediatek package"
	default n
	help
	  Say Y here if you have SYNAPTICS_oppo touch panel.
	  If unsure, say N.
	  To compile this dirver as a module, choose M here: the
	  module will be called. oppo touch panel is has no rest pin and its i2c address is modify
source "drivers/input/touchscreen/mediatek/synaptics_oppo/Kconfig"

endif
```

## drivers/misc/mediatek/alsps/EPL2182-dyn/Kconfig
```kconfig
config MTK_EPL2182_DYN
	bool "MTK_EPL2182_DYN for MediaTek package"
	default n
	help
	It support different type sensor
	in this platform. If this option
	is set, it will support ambient
	and light sensor MTK_EPL2182_DYN.
```

## drivers/misc/mediatek/fingerprint/Kconfig
```kconfig
config HCT_FINGERPRINT_SUPPORT
  bool "HCT_FINGERPRINT_SUPPORT"
  default n

source "drivers/misc/mediatek/fingerprint/gfx1xm/Kconfig"
source "drivers/misc/mediatek/fingerprint/afs120/Kconfig"
source "drivers/misc/mediatek/fingerprint/afs120n/Kconfig"
source "drivers/misc/mediatek/fingerprint/et310/Kconfig"
source "drivers/misc/mediatek/fingerprint/sunwave9551_fp/Kconfig"
source "drivers/misc/mediatek/fingerprint/gf3208_goodix/Kconfig"
source "drivers/misc/mediatek/fingerprint/gf368_goodix/Kconfig"
source "drivers/misc/mediatek/fingerprint/fps998/Kconfig"
```

## drivers/misc/mediatek/fingerprint/gfx1xm/Kconfig
```kconfig
config FINGERPRINT_GFX1XM_GOODIX
        bool "FINGERPRINT_GFX1XM_GOODIX"
        default n
```

## drivers/misc/mediatek/flashlight/Kconfig
```kconfig
config MTK_FLASHLIGHT
  bool CONFIG_MTK_FLASHLIGHT
  default n
  help
    CONFIG_MTK_FLASHLIGHT

config CUSTOM_KERNEL_FLASHLIGHT
        string "CUSTOM_KERNEL_FLASHLIGHT"
        help
          Kernel space cameara flashlight driver. You can use this driver
          choose cameara flashlight type.

config HCT_LED_SGM3785
	bool "HCT CONFIG_HCT_LED_SGM3785"
	default n

config HCT_LED_AW3641
	bool "HCT CONFIG_HCT_LED_AW3641"
	default n
```

## drivers/misc/mediatek/gyroscope/bmi160_gyro/Kconfig
```kconfig
config MTK_BMI160_GYRO
        bool "ITG1010 for MediaTek package"
        default n
        help
        It support different gyroscope sensor.
        If this option is set,
	  	it will support
         ITG1010 gyroscope.
```
